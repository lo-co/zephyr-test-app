## CMakeLists.txt
```
# SPDX-License-Identifier: Apache-2.0

cmake_minimum_required(VERSION 3.20.0)
find_package(Zephyr REQUIRED HINTS $ENV{ZEPHYR_BASE})
project(test)

target_sources(app PRIVATE src/main.c)

add_subdirectory(src/drivers)
add_subdirectory(src/components)

target_include_directories(app PRIVATE ${CMAKE_CURRENT_LIST_DIR}/include)
```

## prj.conf
```kconfig
CONFIG_GPIO=y
CONFIG_LOG=y
CONFIG_LOG_DEFAULT_LEVEL=3
CONFIG_EVENTS=y

# Enable the shell
CONFIG_SHELL=y
CONFIG_SHELL_BACKEND_SERIAL=y

# Optional: history, colors, etc.
CONFIG_SHELL_HISTORY=y
CONFIG_SHELL_CMDS=y

# Use the default UART console
CONFIG_UART_CONSOLE=y

# Allow color
CONFIG_SHELL_VT100_COLORS=y
```

## boards/nucleo_f767zi.overlay
```dts
/ {
    dht11_sensor: dht11_0 {
        compatible = "custom,gpio-data"; 
        gpios = <&gpioc 0 GPIO_ACTIVE_HIGH>;
        label = "DHT11 Data";
    };
};
```

## dts/bindings/custom,gpio-data.yaml
```yaml
description: Simple single-line data

compatible: "custom,gpio-data"

properties:
  gpios:
    type: phandle-array
    required: true
    description: |
      The GPIO connected to the gate data line.
  label:
    type: string
    required: false
    description: |
      Description of data line
```

## src/main.c
```c
/*
 * Copyright (c) 2016 Intel Corporation
 *
 * SPDX-License-Identifier: Apache-2.0
 */

#include <zephyr/drivers/gpio.h>
#include <zephyr/kernel.h>
#include <zephyr/kernel/thread_stack.h>

#include <stdbool.h>

#include <common.h>
#include <dht11.h>
#include <event_module.h>

#include <button_module.h>

LOG_MODULE_REGISTER(main_app, 3);

/*******************************************************************************
 * Definitions
 ******************************************************************************/

/** DHT11 stack size (1 kB) */
#define STACK_SIZE 1024

/* Time to sleep in ms before toggling the green LED */
#define SLEEP_TIME_MS 500

/* The devicetree node identifier for the "led0" alias. */
#define LED0_NODE DT_ALIAS(led0)

/* The devicetree node identifier for the "led0" alias. */
#define LED2_NODE DT_ALIAS(led2)

/*******************************************************************************
 * Type Definitions
 ******************************************************************************/

/*******************************************************************************
 * Function Prototypes
 ******************************************************************************/

/**
 * @brief DHT11 polling thread
 *
 * @param arg1 UNUSED
 * @param arg2 UNUSED
 * @param arg3 UNUSED
 */
static void dht11_thread_start(void *arg1, void *arg2, void *arg3);

/*******************************************************************************
 * Variables
 ******************************************************************************/

/** LED spec based on the DT description */
static const struct gpio_dt_spec green_led = GPIO_DT_SPEC_GET(LED0_NODE, gpios);

/**  Red LED spec based on the DT description */
static const struct gpio_dt_spec red_led = GPIO_DT_SPEC_GET(LED2_NODE, gpios);

/** Define a memory region for the DHT11 thread stack */
K_THREAD_STACK_DEFINE(thread_stack, STACK_SIZE);

/**  DHT11 thread structure */
static struct k_thread dht11_thread;

/*******************************************************************************
 * Function Definitions
 ******************************************************************************/

/**
 * @brief Main application
 *
 * @return int
 */
int main(void) {
  bool led_state = true;

  event_module_init();
  button_module_init();

  if (!gpio_is_ready_dt(&red_led)) {
    COMMON_LOG_ERR("LED GPIO is not ready");
    return -1;
  }

  if (!gpio_is_ready_dt(&green_led)) {
    COMMON_LOG_ERR("LED GPIO is not ready");
    return -1;
  }

  if (gpio_pin_configure_dt(&red_led, GPIO_OUTPUT_ACTIVE)) {
    COMMON_LOG_ERR("Unable to configure pin");
    return -1;
  }

  if (gpio_pin_configure_dt(&green_led, GPIO_OUTPUT_ACTIVE)) {
    COMMON_LOG_ERR("Unable to configure pin");
    return -1;
  }

  gpio_pin_set_dt(&red_led, 0);

  // Create and start the DHT11 acquisition thread
  k_tid_t dht11_tid = k_thread_create(
      &dht11_thread, thread_stack, K_THREAD_STACK_SIZEOF(thread_stack),
      dht11_thread_start, NULL, NULL, NULL, 7, 0, K_NO_WAIT);

  while (1) {
    if (gpio_pin_toggle_dt(&green_led)) {
      return -1;
    }

    led_state = !led_state;
    uint32_t events = event_module_wait_on_event(SLEEP_TIME_MS);

    if (events & EVENT_BUTTON_1S) {
    }
  }
  return 0;
}

// Described above
static void dht11_thread_start(void *arg1, void *arg2, void *arg3) {
  COMMON_LOG_INF("Starting DHT11 thread.");

  if (dht11_init(false)) {
    COMMON_LOG_ERR("DHT11 initialization failed.");
  }
  k_msleep(1000);

  while (1) {
    dht11_data_t data;
    dht11_error_t err = dht11_get_data(NULL, &data);
    if (err) {
      COMMON_LOG_ERR("Error retrieving DHT11 data. Err=%d", err);
    }
    COMMON_LOG_INF("RH=%d, T=%d, parity=%d", data.rh_high, data.t_high, data.parity);
    k_msleep(3000);
  }
}
```

## include/common.h
```c
/**
 * @file common.h
 * @brief Common utilities used here.
 * 
 * 
 */

#pragma once

#include <zephyr/logging/log.h>

// ANSI Coloring for logging
#define ANSI_COLOR_RED     "\033[1;31m"
#define ANSI_COLOR_GREEN   "\033[1;32m"
#define ANSI_COLOR_YELLOW  "\033[1;33m"
#define ANSI_COLOR_BLUE    "\033[1;34m"
#define ANSI_COLOR_MAGENTA "\033[1;35m"
#define ANSI_COLOR_CYAN    "\033[1;36m"
#define ANSI_COLOR_RESET   "\033[0m"


#define COMMON_LOG_INF(fmt, ...) \
    LOG_INF(ANSI_COLOR_GREEN fmt ANSI_COLOR_RESET, ##__VA_ARGS__)

#define COMMON_LOG_ERR(fmt, ...) \
    LOG_ERR(ANSI_COLOR_RED fmt ANSI_COLOR_RESET, ##__VA_ARGS__)

#define COMMON_LOG_DBG(fmt, ...) \
    LOG_DBG(ANSI_COLOR_BLUE fmt ANSI_COLOR_RESET, ##__VA_ARGS__)

#define COMMON_LOG_WRN(fmt, ...) \
    LOG_DBG(ANSI_COLOR_YELLOW fmt ANSI_COLOR_RESET, ##__VA_ARGS__)
```
